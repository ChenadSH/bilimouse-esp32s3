## main/Kconfig.projbuild
```kconfig
menu "BiliMouse"

    config BILIMOUSE_WIFI_SSID
        string "默认 WiFi SSID（OTA 升级用）"
        default "WPP-Guest"
        help
            设备启动后会用这个 SSID 连接 WiFi 检查固件更新。
            可通过串口命令 `wifi set <ssid> <pass>` 覆盖（存 NVS，优先级更高）。

    config BILIMOUSE_WIFI_PASS
        string "默认 WiFi 密码"
        default "connected"
        help
            与 BILIMOUSE_WIFI_SSID 配对使用。串口命令设置的凭据优先。

    config BILIMOUSE_OTA_URL
        string "OTA manifest 地址"
        default "https://raw.githubusercontent.com/CHANGE-ME/bilimouse-ota/main/manifest.json"
        help
            固件版本清单（JSON）的 URL，格式与 GitHub 部署方法见 docs/OTA.md。
            可通过串口命令 `ota url <url>` 覆盖（存 NVS，优先级更高）。

    config BILIMOUSE_OTA_AUTO_CHECK
        bool "开机自动检查并安装更新"
        default n
        help
            开启后开机 30 秒自动检查并静默安装更新。
            默认关闭：只通过屏幕上的「升级」按钮手动触发。
endmenu
```

## sdkconfig.defaults
```kconfig
# ==== BiliMouse 默认配置 ====

# ---- 目标 ----
CONFIG_IDF_TARGET="esp32s3"

# ---- PSRAM (N16R8: 8MB Octal PSRAM) ----
CONFIG_SPIRAM=y
CONFIG_SPIRAM_MODE_OCT=y
CONFIG_SPIRAM_SPEED_80M=y
CONFIG_SPIRAM_USE_MALLOC=y
CONFIG_SPIRAM_TRY_INIT_WITHOUT_RESET=y
CONFIG_SPIRAM_MALLOC_ALWAYSINTERNAL=4096
# 允许把大静态缓冲放进 PSRAM（EXT_RAM_BSS_ATTR），
# 给 WiFi/BLE/LCD DMA 腾出内部 RAM（否则 esp_wifi_init 会 NO_MEM）
CONFIG_SPIRAM_ALLOW_BSS_SEG_EXTERNAL_MEMORY=y
CONFIG_SPIRAM_ALLOW_NOINIT_SEG_EXTERNAL_MEMORY=y

# ---- CPU ----
CONFIG_ESP_DEFAULT_CPU_FREQ_MHZ_240=y
CONFIG_FREERTOS_HZ=1000

# ---- 蓝牙 (BLE HID) ----
CONFIG_BT_ENABLED=y
CONFIG_BT_BLE_42_FEATURES_SUPPORTED=y
CONFIG_BT_NIMBLE_MAX_CONNECTIONS=1
CONFIG_BT_BLE_SMP_ENABLE=y

# ---- 内存分配 ----
CONFIG_HEAP_USE_HOOKS=y
CONFIG_ESP_SYSTEM_PANIC_PRINT_REBOOT=y

# ---- 日志 ----
CONFIG_LOG_DEFAULT_LEVEL_INFO=y

# ---- Flash ----
CONFIG_ESPTOOLPY_FLASHMODE_QIO=y
CONFIG_ESPTOOLPY_FLASHFREQ_80M=y
CONFIG_ESPTOOLPY_FLASHSIZE_16MB=y

# ---- 分区表 ----
# 必须用自定义表：默认的 single-app 表没有 irbank 分区，
# 红外学习到的遥控器码就只有 NVS 一份副本（易被擦掉）。
CONFIG_PARTITION_TABLE_CUSTOM=y
CONFIG_PARTITION_TABLE_CUSTOM_FILENAME="partitions.csv"
CONFIG_PARTITION_TABLE_FILENAME="partitions.csv"

# ---- OTA / WiFi ----
# OTA 升级后新固件未确认就重启 -> 自动回滚旧版本（安全网）
CONFIG_BOOTLOADER_APP_ROLLBACK_ENABLE=y
# 家庭局域网用明文 HTTP 分发固件（生产环境应换 HTTPS 并配服务器证书）
CONFIG_ESP_HTTPS_OTA_ALLOW_HTTP=y

# 出厂默认 WiFi（串口 wifi set 存的凭据最优先）
CONFIG_BILIMOUSE_WIFI_SSID="WPP-Guest"
CONFIG_BILIMOUSE_WIFI_PASS="connected"
CONFIG_BILIMOUSE_WIFI_SSID2="Grey Shanghai"
CONFIG_BILIMOUSE_WIFI_PASS2="23202288"
CONFIG_BILIMOUSE_WIFI_SSID3="九天诛仙"
CONFIG_BILIMOUSE_WIFI_PASS3="20158888"
# GitHub Releases 固定链接（永远指向最新版 manifest）
CONFIG_BILIMOUSE_OTA_URL="https://github.com/ChenadSH/bilimouse-esp32s3/releases/latest/download/manifest.json"

# ---- FATFS ----
# IDF v6 的 fatfs 组件默认不带这些 Kconfig 值，需显式声明，
# 否则 ffconf.h 会引用未定义的 CONFIG_FATFS_USE_LABEL 导致编译失败。
CONFIG_FATFS_USE_LABEL=y
CONFIG_FATFS_API_ENCODING_UTF_8=n
CONFIG_FATFS_CODEPAGE=437
CONFIG_FATFS_FAT12=n
CONFIG_FATFS_LFN_HEAP=y
CONFIG_FATFS_LFN_MAX=255
CONFIG_FATFS_MKFS_PERCENT=10
CONFIG_FATFS_PER_FILE_CACHE=n
CONFIG_FATFS_VOLUME_COUNT=2
CONFIG_FATFS_VOLUME_LABEL=""
CONFIG_FATFS_IMMEDIATE_FSYNC=n
CONFIG_FATFS_LINK_LOCK=y
CONFIG_FATFS_USE_DYN_BUFFERS=y
CONFIG_FATFS_USE_FASTSEEK=n
CONFIG_FATFS_USE_STRFUNC_NONE=n
CONFIG_FATFS_PRINT_LLI=n
CONFIG_FATFS_PRINT_FLOAT=n
# WiFi 缓冲瘦身：内部 RAM 紧张（BLE+LCD+音频共存），默认值会让
# esp_wifi_init 分配静态接收缓冲失败（NO_MEM），WiFi 直接起不来
CONFIG_ESP_WIFI_STATIC_RX_BUFFER_NUM=6
```
